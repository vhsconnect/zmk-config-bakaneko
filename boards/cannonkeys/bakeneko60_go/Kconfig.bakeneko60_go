## boards/cannonkeys/bakeneko60_go/Kconfig.bakeneko60_go
```kconfig
# Copyright (c) 2023 Andrew Kannan
# SPDX-License-Identifier: MIT

config BOARD_BAKENEKO60_GO
    select SOC_NRF52840_QIAA
    select ZMK_BOARD_COMPAT if BOARD_BAKENEKO60_GO_NRF52840_ZMK
    imply RETAINED_MEM if BOARD_BAKENEKO60_GO_NRF52840_ZMK
    imply RETENTION if BOARD_BAKENEKO60_GO_NRF52840_ZMK
    imply RETENTION_BOOT_MODE if BOARD_BAKENEKO60_GO_NRF52840_ZMK
```
